## conf/layer.conf
```bitbake
# We have a conf and classes directory, add to BBPATH
BBPATH .= ":${LAYERDIR}"

# We have recipes-* directories, add to BBFILES
BBFILES += "${LAYERDIR}/recipes/*.bb \
            ${LAYERDIR}/recipes/*.bbappend"

BBFILE_COLLECTIONS += "meta-ulug"
BBFILE_PATTERN_meta-ulug = "^${LAYERDIR}/"
BBFILE_PRIORITY_meta-ulug = "6"

LAYERDEPENDS_meta-ulug = "core"
LAYERSERIES_COMPAT_meta-ulug = "kirkstone langdale"
```
